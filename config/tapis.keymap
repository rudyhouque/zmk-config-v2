#include <behaviors.dtsi>
#include <dt-bindings/zmk/keys.h>
#include <dt-bindings/zmk/bt.h>

/ {
    keymap {
        compatible = "zmk,keymap";
        default_layer {
            bindings = <
                &kp Q   &kp B   &kp C   &bt BT_NXT   &bt BT_CLR_ALL
            >;
        };
    };
};
